## conf/local.conf
```bitbake
[project]
SECRET_KEY='django-insecure-dqosnmpz!k3qv4@h)dfvfqa*#i8lba6(#95l7w9uu6-1y9_*1i'

[centrifuge]
ENABLED: True
HOST: http://localhost:8035/
URL: /centrifugo
API_KEY: RtYz5GoqVqJ5
SECRET: dRMmPyUZPXCb

[smtp]
HOST: localhost
PORT: 1025
SENDER_EMAIL: no-reply@seminar-tech.ru
UNSUBSCRIBE_TOKEN: fillme
```
